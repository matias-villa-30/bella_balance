## esp32/ble_server/sdkconfig.defaults
```kconfig
# Enable Bluetooth and NimBLE stack
CONFIG_BT_ENABLED=y
CONFIG_BT_NIMBLE_ENABLED=y

# Standardize Flash size for C3 (Optional but helpful)
CONFIG_ESPTOOLPY_FLASHSIZE_4MB=y
CONFIG_ESPTOOLPY_FLASHSIZE="4MB"

# Increase stack size for BLE host task to prevent overflows
CONFIG_BT_NIMBLE_HOST_TASK_STACK_SIZE=4096
```
